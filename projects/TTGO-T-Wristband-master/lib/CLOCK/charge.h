#include "Arduino.h"
#include "esp_adc_cal.h"
#include "SetUp.h"

const unsigned short charge[0x220] ={
0x0000, 0x0000, 0x0000, 0x0000, 0x0000, 0x0000, 0x0000, 0x0000, 0x0000, 0x0000, 0x0000, 0x0000, 0x0000, 0x0000, 0x0000, 0x0000,   // 0x0010 (16)
0x0000, 0x0000, 0x0000, 0x0000, 0x0000, 0x0000, 0x0000, 0x0000, 0x0000, 0x0000, 0x0000, 0x0000, 0x0000, 0x0000, 0xD901, 0x0000,   // 0x0020 (32)
0x0000, 0x0000, 0x0000, 0x0000, 0x0000, 0x0000, 0x0000, 0x0000, 0x0000, 0x0000, 0x0000, 0x0000, 0x0000, 0x0000, 0x0000, 0x0000,   // 0x0030 (48)
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0x0000, 0x0000, 0x0000, 0x0000, 0x0000, 0x0000, 0x0000, 0x0000, 0x0000, 0x0000, 0x0000, 0x0000, 0x0000, 0x0000, 0x0000, 0x0000,   // 0x0220 (544)
};

int vref = 1100;
void setupADC()
{
    esp_adc_cal_characteristics_t adc_chars;
    esp_adc_cal_value_t val_type = esp_adc_cal_characterize((adc_unit_t)ADC_UNIT_1, (adc_atten_t)ADC1_CHANNEL_6, (adc_bits_width_t)ADC_WIDTH_BIT_12, 1100, &adc_chars);
    //Check type of calibration value used to characterize ADC
    if (val_type == ESP_ADC_CAL_VAL_EFUSE_VREF) {
        Serial.printf("eFuse Vref:%u mV", adc_chars.vref);
        vref = adc_chars.vref;
    } else if (val_type == ESP_ADC_CAL_VAL_EFUSE_TP) {
        Serial.printf("Two Point --> coeff_a:%umV coeff_b:%umV\n", adc_chars.coeff_a, adc_chars.coeff_b);
    } else {
        Serial.println("Default Vref: 1100mV");
    }
}
inline float BTVoltage()
{
  uint16_t v = analogRead(BATT_ADC_PIN);
  float battery_voltage = ((float)v / 4095.0) * 2.0 * 3.3 * (vref / 1000.0);
  return battery_voltage;
}

inline float BTLEVEL()
{
  float btl=mapfloat(BTVoltage(),3.5,4.3,1.f,100.f);
  if(100.f<btl)btl=100.0f;
  if(btl<=0.f)btl=1;
  return btl;
}

inline String getVoltage()
{
  return String(BTVoltage()) + "V";
}

void BTlevel(TFT_eSPI *tft,int x,int y,float it=0.5f,bool ton=false)
{
  char buff[256];
  const int h=10;
  const int w=20;
  int level=0;
  int color[5]={TFT_WHITE,TFT_GREEN,TFT_BLACK,TFT_RED,TFT_YELLOW};
  if(t[1].stand_by(it)||ton)
  {
    /*枠*/
    for(int i=x;i<x+1;i++)
      for(int j=y+(h/2)-2;j<y+(h/2)+2;j++)
        tft->drawPixel(i,j,color[0]);
    for(int i=x+1;i<x+2;i++)
      for(int j=y;j<y+h+1;j++)
        tft->drawPixel(i,j,color[0]);
    for(int i=x+2;i<x+w-1;i++)
      for(int j=y;j<y+h+1;j++)
        if(j==y+h||j==y)
          tft->drawPixel(i,j,color[0]);
    for(int i=x+w-1;i<x+w;i++)
      for(int j=y;j<y+h+1;j++)
        tft->drawPixel(i,j,color[0]);
    /*残量表示*/
    float btl=BTLEVEL();

    level=20-(int)mapfloat(btl,1.0f,100.0f,3,20);
    if(level>17)level=17;
    int cnum=(level>=15)?3:(level>=12)?4:1;
    tft->setTextColor(color[cnum],TFT_BLACK);
    if(btl<=30)sleeptime=10;
    else sleeptime=30;
    if(digitalRead(CHARGE_PIN) == LOW)
    {
      sleeptime=60;
      static byte num=0;
      level=0;
      tft->setTextColor(TFT_YELLOW,TFT_BLACK);
      cnum=4;
      switch(num)
      {
        case 0:snprintf(buff, sizeof(buff), "    ");break;
        case 1:snprintf(buff, sizeof(buff), "  - ");break;
        case 2:snprintf(buff, sizeof(buff), " -- ");break;
        case 3:snprintf(buff, sizeof(buff), "<-- ");
        default:num=-1;break;
      }
      num++;
    }
    else
      snprintf(buff, sizeof(buff), "%.0f%% ",btl);
    for(int i=x+2+level;i<x+w-1;i++)
      for(int j=y+1;j<y+h;j++)
        tft->drawPixel(i,j,color[cnum]);
    for(int i=x+2;i<x+2+level;i++)
      for(int j=y+1;j<y+h;j++)
        tft->drawPixel(i,j,color[2]);
    tft->drawString(buff,x+w+1,y);
    tft->drawString(getVoltage(),x+w+1,y+12);
  }
}